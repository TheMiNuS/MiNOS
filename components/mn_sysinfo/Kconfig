## components/mn_sysinfo/Kconfig
```kconfig
menu "MiNOS - System infos"
    config MINOS_SYSINFO_ENABLE
        bool "Enable mn_sysinfo (System infos page)"
        default n
        help
            Adds a /sysinfo page to the HTTPS server and a "System infos" button on the home page.
            The feature is also gated at runtime via g_mn_sysinfo_runtime_enable.
endmenu
```

## components/mn_web/Kconfig
```kconfig
menu "MiNOS Web"

config MINOS_WEB_USE_HTTPS
    bool "Use HTTPS server (TLS)"
    default y
    help
        If enabled, MiNOS starts the HTTPS server (esp_https_server) on port 443.
        If disabled, MiNOS starts the plain HTTP server (esp_http_server) on port 80.

endmenu
```

## sdkconfig.defaults
```kconfig
CONFIG_ESP_MAIN_TASK_STACK_SIZE=8192
CONFIG_ESP_CONSOLE_UART_DEFAULT=y
CONFIG_IDF_TARGET="esp32"
#
#
# Flash size 4MB
CONFIG_ESPTOOLPY_FLASHSIZE_4MB=y
CONFIG_ESPTOOLPY_FLASHSIZE="4MB"
#
#
# Partition table: custom file
CONFIG_PARTITION_TABLE_CUSTOM=y
CONFIG_PARTITION_TABLE_FILENAME="partitions.csv"
CONFIG_PARTITION_TABLE_CUSTOM_FILENAME="partitions.csv"
# Offset standard
CONFIG_PARTITION_TABLE_OFFSET=0x8000
#
#
# Section for SSL Server configuration.
# Configure here if you want HTTPS or HTTP.
# Keep in mind that you need to generate certificates for HTTPS.
# Follow the procedure in the readme and install your Certificate Authority on your devices.
CONFIG_MINOS_WEB_USE_HTTPS=n
#
CONFIG_LWIP_MAX_SOCKETS=7
CONFIG_MBEDTLS_DYNAMIC_BUFFER=y
CONFIG_MBEDTLS_SSL_IN_CONTENT_LEN=16384
CONFIG_MBEDTLS_SSL_OUT_CONTENT_LEN=4096
CONFIG_MBEDTLS_SSL_KEEP_PEER_CERTIFICATE=n
#
#
#Section for Sysinfo module.
CONFIG_FREERTOS_USE_TRACE_FACILITY=y
CONFIG_FREERTOS_USE_STATS_FORMATTING_FUNCTIONS=y
CONFIG_FREERTOS_GENERATE_RUN_TIME_STATS=y
CONFIG_FREERTOS_RUN_TIME_STATS_USING_ESP_TIMER=y
#CONFIG_FREERTOS_CORE_AFFINITY=y
#CONFIG_FREERTOS_SMP=y
#
CONFIG_MINOS_SYSINFO_ENABLE=y
#
#
#Section to manage errors handling on the UART.
CONFIG_LOG_DEFAULT_LEVEL_NONE=y
CONFIG_LOG_DEFAULT_LEVEL_ERROR=y
CONFIG_LOG_DEFAULT_LEVEL_WARN=y
CONFIG_LOG_DEFAULT_LEVEL_INFO=n
CONFIG_LOG_DEFAULT_LEVEL_DEBUG=n
CONFIG_LOG_DEFAULT_LEVEL_VERBOSE=n
#
#
# Performance optimization
CONFIG_COMPILER_OPTIMIZATION_PERF=y
```
